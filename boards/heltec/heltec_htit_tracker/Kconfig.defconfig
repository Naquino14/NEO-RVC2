## boards/heltec/heltec_htit_tracker/heltec_htit_tracker_procpu_defconfig
```kconfig
# SPDX-License-Identifier: Apache-2.0

CONFIG_MAIN_STACK_SIZE=2048

CONFIG_SERIAL=y
CONFIG_USB_DEVICE_STACK_NEXT=y
CONFIG_USBD_CDC_ACM_CLASS=y
CONFIG_CDC_ACM_SERIAL_INITIALIZE_AT_BOOT=n

CONFIG_LVGL=y
CONFIG_LV_COLOR_DEPTH_16=y
CONFIG_LV_COLOR_16_SWAP=y

CONFIG_GPIO=y
CONFIG_PWM=y

CONFIG_UFIREBIRDII=y
CONFIG_UC6580=y
```

## drivers/ufirebirdii/Kconfig
```kconfig
# Copyright (c) 2021 Nordic Semiconductor ASA
# SPDX-License-Identifier: Apache-2.0

config UFIREBIRDII
    bool "UFirebirdII GNSS Device Family Support"
    help
      Enable support for the UFirebirdII GNSS device family.

if UFIREBIRDII
rsource "uc6580/Kconfig"
endif 
```

## drivers/ufirebirdii/uc6580/Kconfig
```kconfig
# Copyright (C) 2026 Nate Aquino
# SPDX-License-Identifier: Apache-2.0

config UC6580
    bool "Unicore UC6580"
    select UART
    select RING_BUFFER
    help
        Enable support for the Unicore UC6580 GNSS receiver. 

config UC6580_RINGBUFFER_SIZE
    depends on UC6580
    int "UC6580 UART Ring Buffer Size"
    default 1024
    help
        Set the size of the ring buffer used for UART reception in the UC6580 driver.
```

## drivers/ufirebirdii_gnss/Kconfig
```kconfig
menuconfig UFIREBIRDII_GNSS
    bool "Unicore UFirebirdII GNSS drivers"
    default y

if UFIREBIRDII_GNSS
    config UFIREBIRDII_GNSS_UC6580
    depends on UART
    default y
    help
        Enable Unicore UC65380 GNSS receiver.

endif # GNSS
```

## dts/bindings/gnss/unicore,uc6580.yaml
```yaml
# Copyright (c) 2026, Nate Aquino 
# SPDX-License-Identifier: Apache-2.0

title:
  Unicore UC6580 GNSS receiver
description: |
  The Unicore UC6580A and UC6580I are dual-frequency multi-constellation GNSS SoC. 
  It supports GPS, BDS, GONLASS, Galileio, QZSS, NavIC, and SBAS. It supports 1, 5, or 10 HZ updates, 
  and uses the NMEA-0183 standard, RTCM and RTCM extended, as well as Unicore's own sentences. Though this driver uses UART, 
  the SoC itself supports SPI and I2S as well. 

compatible: "unicore,uc6580"

include: uart-device.yaml

properties: 
  reg:
    required: false
```

## dts/bindings/ufirebirdii/unicore,uc6580.yaml
```yaml
description: |
    The Unicore UC6580 is a dual-frequency, multi-constellation GNSS SoC.

compatible: "unicore,uc6580"

include: uart-device.yaml

properties:
    pps-gpios:
        type: phandle-array
        description: "GPIO pin for PPS signal"
        required: false
```

## west.yml
```yaml
# Copyright (c) 2021 Nordic Semiconductor ASA
# SPDX-License-Identifier: Apache-2.0

manifest:
  remotes:
    - name: zephyrproject-rtos
      url-base: https://github.com/zephyrproject-rtos

  group-filter:
  - -babblesim
  - -testing
  - -optional
  projects:
  - name: zephyr
    url: https://github.com/zephyrproject-rtos/zephyr
    revision: 02191db6fe3aaa809a75743b4eb9561a08d32fc2
    west-commands: scripts/west-commands.yml
  - name: fatfs
    url: https://github.com/zephyrproject-rtos/fatfs
    revision: f4ead3bf4a6dab3a07d7b5f5315795c073db568d
    path: modules/fs/fatfs
    groups:
    - fs
  - name: hal_espressif
    url: https://github.com/zephyrproject-rtos/hal_espressif
    revision: 928f0184a9fd68e71c6fbd7e58b28dbbccd632aa
    path: modules/hal/espressif
    west-commands: west/west-commands.yml
    groups:
    - hal
  - name: loramac-node
    url: https://github.com/zephyrproject-rtos/loramac-node
    revision: fb00b383072518c918e2258b0916c996f2d4eebe
    path: modules/lib/loramac-node
  - name: lvgl
    url: https://github.com/zephyrproject-rtos/lvgl
    revision: 94ae6c0535aa6ac4b08a75f4ae2c3a08cacb5c41
    path: modules/lib/gui/lvgl
  - name: mbedtls
    url: https://github.com/zephyrproject-rtos/mbedtls
    revision: c5b06d89c9c498d8fc8659ce31f7e53137b6270f
    path: modules/crypto/mbedtls
    groups:
    - crypto
  - name: mcuboot
    url: https://github.com/zephyrproject-rtos/mcuboot
    revision: d9c2ba153128efd7c16db9f36dea4ee69f63c7f5
    path: bootloader/mcuboot
    groups:
    - bootloader
  self:
    path: NEO-RVC2.git
```
